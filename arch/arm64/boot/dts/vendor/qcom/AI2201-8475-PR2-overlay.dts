/dts-v1/;
/plugin/;

#include "AI2201-8475-PR-overlay.dts"

/ {
	model = "Qualcomm Technologies, Inc. ASUS AI2201 8475 PR2";
	compatible = "qcom,cape-mtp", "qcom,cape", "qcom,mtp";
	qcom,msm-id = <530 0x10000>, <531 0x10000>, <540 0x10000>;
	qcom,board-id = <62 0>;
};

/*   ====================================
*    overlay for display - start
*    ====================================
*/

/*   ====================================
*    overlay for display - end
*    ====================================
*/

/*   ====================================
*    overlay for touch - start
*    ====================================
*/

/*   ====================================
*    overlay for touch - end
*    ====================================
*/

/*    ====================================
 *    overlay for cape.dtsi - start
 *    ====================================
 */

/*   ====================================
*    overlay for aura - start
*    ====================================
*/


&qupv3_se15_spi {
    status = "disable";
};
&qupv3_se15_i2c {
    status = "ok";
    ms51@16 {
        compatible = "ms51_phone";
        reg = <0x16>;


        nuvoton,aura_3p3_en = <0 0 0>;
        nuvoton,front_led_en = <0 0 0>;
        nuvoton,logo_5p0_en = <&pm8350_gpios 1 0x0>;
        nuvoton,wakeup_pin = <&tlmm 109 0>;
        nuvoton,hw_stage = <5>;
    };
};

/*   ====================================
*    overlay for aura - end
*    ====================================
*/
/*    ====================================
 *    overlay for cape.dtsi - end
 *    ====================================
 */

/*    ====================================
 *    overlay for cape-mtp.dtsi - start
 *    ====================================
 */

/*    ====================================
 *    overlay for cape-mtp.dtsi - end
 *    ====================================
 */

/*    ====================================
 *    overlay for cape-pinctrl.dtsi - start
 *    ====================================
 */

/*    ====================================
 *    overlay for cape-pinctrl.dtsi - end
 *    ====================================
 */

 /*    ====================================
 *    overlay for cape-pmic-overlay.dtsi - start
 *    ====================================
 */

 /*    ====================================
 *    overlay for cape-pmic-overlay.dtsi - end
 *    ====================================
 */

 /*    ====================================
 *    overlay for cape-regulators.dtsi - start
 *    ====================================
 */

/*    ====================================
 *    overlay for cape-regulators.dtsi - end
 *    ====================================
 */
