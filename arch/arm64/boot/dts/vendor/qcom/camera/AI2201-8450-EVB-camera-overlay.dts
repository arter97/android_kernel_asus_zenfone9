/dts-v1/;
/plugin/;

#include "waipio-camera-sensor-mtp.dts"

/ {
	model = "Qualcomm Technologies, Inc. ASUS AI2201 8450 EVB1";
	compatible = "qcom,waipio", "qcom,waipiop";
	qcom,msm-id = <457 0x10000>, <482 0x10000>, <457 0x20000>, <482 0x20000>;
	qcom,board-id = <30 0>;
};
