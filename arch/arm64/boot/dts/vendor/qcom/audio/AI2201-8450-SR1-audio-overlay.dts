/dts-v1/;
/plugin/;

#include "AI2201-8450-SR1-audio-overlay.dtsi"
/ {
	model = "Qualcomm Technologies, Inc. ASUS AI2201 8450 SR1";
	compatible = "qcom,waipio-mtp", "qcom,waipio", "qcom,mtp";
	qcom,msm-id = <457 0x10000>, <482 0x10000>, <457 0x20000>, <482 0x20000>;
	qcom,board-id = <41 0>, <0x02010008 0>, <0x03010008 0x03>;
};
