/dts-v1/;
/plugin/;

#include "AI2202-8475-PR2-overlay.dts"

/ {
	model = "Qualcomm Technologies, Inc. ASUS AI2202 8475 PR3";
	compatible = "qcom,cape-mtp", "qcom,cape", "qcom,mtp";
	qcom,msm-id = <530 0x10000>, <531 0x10000>, <540 0x10000>;
	qcom,board-id = <76 0>;
};

/*   ====================================
*    overlay for display - start
*    ====================================
*/

/*   ====================================
*    overlay for display - end
*    ====================================
*/

/*   ====================================
*    overlay for touch - start
*    ====================================
*/

/*   ====================================
*    overlay for touch - end
*    ====================================
*/

/*    ====================================
 *    overlay for cape.dtsi - start
 *    ====================================
 */

/*    ====================================
 *    overlay for cape.dtsi - end
 *    ====================================
 */

/*    ====================================
 *    overlay for cape-mtp.dtsi - start
 *    ====================================
 */

/*    ====================================
 *    overlay for cape-mtp.dtsi - end
 *    ====================================
 */

/*    ====================================
 *    overlay for cape-pinctrl.dtsi - start
 *    ====================================
 */

/*    ====================================
 *    overlay for cape-pinctrl.dtsi - end
 *    ====================================
 */

 /*    ====================================
 *    overlay for cape-pmic-overlay.dtsi - start
 *    ====================================
 */

 /*    ====================================
 *    overlay for cape-pmic-overlay.dtsi - end
 *    ====================================
 */

 /*    ====================================
 *    overlay for cape-regulators.dtsi - start
 *    ====================================
 */

/*    ====================================
 *    overlay for cape-regulators.dtsi - end
 *    ====================================
 */
