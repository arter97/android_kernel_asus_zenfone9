/dts-v1/;
/plugin/;

#include "AI2202-8475-EVB-audio-overlay.dtsi"
/ {
	model = "Qualcomm Technologies, Inc. ASUS AI2202 8475 EVB";
	compatible = "qcom,cape-mtp", "qcom,cape", "qcom,mtp";
	qcom,msm-id = <530 0x10000>, <531 0x10000>, <540 0x10000>;
	qcom,board-id = <36 0>;
};
