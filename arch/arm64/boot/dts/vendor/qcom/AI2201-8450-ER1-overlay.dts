/dts-v1/;
/plugin/;


#include "AI2201-8450-SR2-overlay.dts"
/ {
	model = "Qualcomm Technologies, Inc. ASUS AI2201 8450 ER1";
	compatible = "qcom,waipio-mtp", "qcom,waipio", "qcom,mtp";
	qcom,msm-id = <457 0x10000>, <482 0x10000>, <457 0x20000>, <482 0x20000>;
	qcom,board-id = <50 0>, <0x03010008 0x03>;
};
/*   ====================================
*    overlay for display - start
*    ====================================
*/

/*   ====================================
*    overlay for display - end
*    ====================================
*/

/*   ====================================
*    overlay for touch - start
*    ====================================
*/


/*   ====================================
*    overlay for touch - end
*    ====================================
*/

/*    ====================================
 *    overlay for waipio.dtsi - start
 *    ====================================
 */

/*    ====================================
 *    overlay for waipio.dtsi - end
 *    ====================================
 */



/*    ====================================
 *    overlay for waipio-mtp.dtsi - start
 *    ====================================
 */

&qupv3_se9_i2c{
	status = "ok";

	Semtech_sx932x@28 {
		status = "disable";
	};
};

/*    ====================================
 *    overlay for waipio-mtp.dtsi - end
 *    ====================================
 */


/*    ====================================
 *    overlay for waipio-pinctrl.dtsi - start
 *    ====================================
 */


/*    ====================================
 *    overlay for waipio-pinctrl.dtsi - end
 *    ====================================
 */

/*    ====================================
 *    overlay for waipio-qupv3.dtsi - start
 *    ====================================
 */

//PMOLED
&futaba_pmoled {
	asus,hardware-stage = "er";
};

/*    ====================================
 *    overlay for waipio-qupv3.dtsi - end
 *    ====================================
 */

/*    ====================================
 *    overlay for waipio-pmic-overlay.dtsi - start
 *    ====================================
 */

/*    ====================================
 *    overlay for waipio-pmic-overlay.dtsi - end
 *    ====================================
 */


/*    ====================================
 *    overlay for pm8450.dtsi - start
 *    ====================================
 */

/*    ====================================
 *    overlay for pm8450.dtsi - end
 *    ====================================
 */


/*    ====================================
 *    overlay for waipio-regulators.dtsi - start
 *    ====================================
 */

/*    ====================================
 *    overlay for waipio-regulators.dtsi - end
 *    ====================================
 */



/*    ====================================
 *    overlay for waipio-audio.dtsi - start
 *    ====================================
 */

/*    ====================================
 *    overlay for waipio-audio.dtsi - end
 *    ====================================
 */

/*    ====================================
 *    overlay for waipio-audio-overlay.dtsi - start
 *    ====================================
 */

/*    ====================================
 *    overlay for waipio-audio-overlay.dtsi - end
 *    ====================================
 */


/*    ====================================
 *    overlay for waipio-thermal-overlay.dtsi - start
 *    ====================================
 */

/*    ====================================
 *    overlay for waipio-thermal-overlay.dtsi - end
 *    ====================================
 */


/*    ====================================
 *    overlay for waipio-gpu.dtsi - start
 *    ====================================
 */

/*    ====================================
 *    overlay for waipio-gpu.dtsi - end
 *    ====================================
 */


/*    ====================================
 *    overlay for waipio-usb.dtsi - start
 *    ====================================
 */

/*    ====================================
 *    overlay for waipio-usb.dtsi - end
 *    ====================================
 */
