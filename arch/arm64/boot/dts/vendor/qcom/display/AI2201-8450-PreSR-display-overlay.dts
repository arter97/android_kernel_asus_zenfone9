/dts-v1/;
/plugin/;

#include "AI2201-8450-EVB-display-overlay.dts"

/ {
	model = "Qualcomm Technologies, Inc. ASUS AI2201 8450 PreSR";
	compatible = "qcom,waipio-mtp", "qcom,waipio", "qcom,mtp";
	qcom,msm-id = <457 0x10000>, <482 0x10000>, <457 0x20000>, <482 0x20000>;
	qcom,board-id = <40 0>;
};

/*   ====================================
*    overlay for display - start
*    ====================================
*/

&dsi_ams678_fhd_plus_dsc_cmd {
	/delete-property/ qcom,platform-px-reset-gpio;
	/delete-property/ qcom,platform-px-wakeup-gpio;
	/delete-property/ qcom,platform-px-ready-gpio;
};

&dsi_ams678_er2_fhd_plus_dsc_cmd {
	/delete-property/ qcom,platform-px-reset-gpio;
	/delete-property/ qcom,platform-px-wakeup-gpio;
	/delete-property/ qcom,platform-px-ready-gpio;
};

/*   ====================================
*    overlay for display - end
*    ====================================
*/
