## drivers/gamepad_hid_driver/Kconfig
```kconfig
config KUNAI3_DRIVER
	tristate "ASUS Kuni3 GamePad"
	default n
	help
		Enable Kuni3 GamePad driver
		If unsure, say N.
```

## drivers/gpu/pmoled/Kconfig
```kconfig
# SPDX-License-Identifier: GPL-2.0-only

config DRM_PANEL_FUTABA_SSD1362
	tristate "Futaba ssd1362 PMOLED"
	depends on SPI
	help
	  Say Y here if you want to enable support for Futaba ssd1362 PMOLED panel
```

## drivers/motor/awinic/869xx/Kconfig
```kconfig
#menu "aw haptic driver support"

config AW_HAPTIC
	tristate "aw haptic driver support"
	default n

#endmenu
```

## drivers/msp/Kconfig
```kconfig
#menu "TI MSP430 driver support"

config TI_MSP430
	tristate "TI MSP430 driver support"
	default n

#endmenu
```

## drivers/rog_accy/Kconfig
```kconfig
config ROG_ACCY_DRIVER
    tristate "ROG Phone 6 ACCY driver"
	default n
	help
		Enable ROG Phone 6 ACCY drvier kernel module
		If unsure, say N.
```
