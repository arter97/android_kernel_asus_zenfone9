/dts-v1/;
/plugin/;

#include "AI2201-8475-EVB_ER1-camera-overlay.dts"

/ {
	model = "Qualcomm Technologies, Inc. ASUS AI2201 8475 ER2";
	compatible = "qcom,cape", "qcom,capep";
	qcom,msm-id = <530 0x10000>;
	qcom,board-id = <53 0>;
};
