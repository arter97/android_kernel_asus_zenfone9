/dts-v1/;
/plugin/;

#include "AI2202-ER-display-overlay.dts"

/ {
	model = "Qualcomm Technologies, Inc. ASUS AI2202 ER2-2";
	compatible = "qcom,waipio-mtp", "qcom,waipio", "qcom,mtp";
	qcom,msm-id = <457 0x10000>, <482 0x10000>, <457 0x20000>, <482 0x20000>;
	qcom,board-id = <75 0>;
};
/*   ====================================
*    overlay for display - start
*    ====================================
*/

/*   ====================================
*    overlay for display - end
*    ====================================
*/
