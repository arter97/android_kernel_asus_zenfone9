/dts-v1/;
/plugin/;

#include "AI2201-8475-ER2-audio-overlay.dtsi"
 / {
	model = "Qualcomm Technologies, Inc. ASUS AI2201 8475 ER2";
	compatible = "qcom,cape-mtp", "qcom,cape", "qcom,mtp";
	qcom,msm-id = <530 0x10000>, <540 0x10000>;
	qcom,board-id = <53 0>;
};
