/dts-v1/;
/plugin/;

#include "AI2202-8475-EVB-overlay.dts"

/ {
	model = "Qualcomm Technologies, Inc. ASUS AI2202 8475 ER2";
	compatible = "qcom,cape-mtp", "qcom,cape", "qcom,mtp";
	qcom,msm-id = <530 0x10000>, <531 0x10000>, <540 0x10000>;
	qcom,board-id = <46 0>;
};

/*   ====================================
*    overlay for display - start
*    ====================================
*/

/*   ====================================
*    overlay for display - end
*    ====================================
*/

/*   ====================================
*    overlay for touch - start
*    ====================================
*/

/*   ====================================
*    overlay for touch - end
*    ====================================
*/

/*    ====================================
 *    overlay for cape.dtsi - start
 *    ====================================
 */

/*    ====================================
 *    overlay for cape.dtsi - end
 *    ====================================
 */

/*    ====================================
 *    overlay for cape-mtp.dtsi - start
 *    ====================================
 */

&nxp_eusb2_repeater {
	qcom,param-override-seq =
			 <0x60 0x06
			  0x01 0x07
			  0x63 0x08
			  0x03 0x09>;
};

/*    ====================================
 *    overlay for cape-mtp.dtsi - end
 *    ====================================
 */

/*    ====================================
 *    overlay for cape-pinctrl.dtsi - start
 *    ====================================
 */

/*    ====================================
 *    overlay for cape-pinctrl.dtsi - end
 *    ====================================
 */

 /*    ====================================
 *    overlay for cape-pmic-overlay.dtsi - start
 *    ====================================
 */

 /*    ====================================
 *    overlay for cape-pmic-overlay.dtsi - end
 *    ====================================
 */

 /*    ====================================
 *    overlay for cape-regulators.dtsi - start
 *    ====================================
 */

/*    ====================================
 *    overlay for cape-regulators.dtsi - end
 *    ====================================
 */
