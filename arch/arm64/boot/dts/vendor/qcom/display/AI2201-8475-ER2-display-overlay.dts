/dts-v1/;
/plugin/;

#include "AI2201-8475-EVB_ER1-display-overlay.dts"

/ {
	model = "Qualcomm Technologies, Inc. ASUS AI2201 8475 ER2";
	compatible = "qcom,cape-mtp", "qcom,cape", "qcom,mtp";
	qcom,msm-id = <530 0x10000>, <531 0x10000>, <540 0x10000>;
	qcom,board-id = <53 0>;
};

/*   ====================================
*    overlay for display - start
*    ====================================
*/


/*   ====================================
*    overlay for display - end
*    ====================================
*/
